/* Hardware configuration for atmega644p. Generated by gen_devices.py. */
#define FLASH_SIZE 65536
#define EEPROM_SIZE 2048
#define FLASH_PAGE_BYTES 256
#define SIG0 0x1e
#define SIG1 0x96
#define SIG2 0xa
#define SRAM_END 0x10ff
#define MINI_UART_STYLE 0
#define MINI_LEGACY_STACK 0
#define MINI_VIRTUAL_BOOT 0
#define MCUSR_IO 0x34
#define MINI_SPM_EXT 0
#define MINI_FLASH_BANKED 0
#define MINI_FLASH_128K 0
#define MINI_FLASH_256K 0
#define SPMCSR_IO 0x37
#define SPMCSR_MEM 0x57
#define WDT_IO 0x21
#define EEPROM_EECR_IO 0x1f
#define EEPROM_EEDR_IO 0x20
#define EEPROM_EEARL_IO 0x21
#define EEPROM_EEARH_IO 0x22
#ifndef BOOT_BYTES
#define BOOT_BYTES 1024
#endif
#define BOOT_START (FLASH_SIZE - BOOT_BYTES)
