/* Hardware configuration for atmega16. Generated by gen_devices.py. */
#define FLASH_SIZE 16384
#define EEPROM_SIZE 512
#define FLASH_PAGE_BYTES 128
#define SIG0 0x1e
#define SIG1 0x94
#define SIG2 0x3
#define SRAM_END 0x45f
#define MINI_UART_STYLE 1
#define MINI_LEGACY_STACK 1
#define MINI_VIRTUAL_BOOT 0
#define MCUSR_IO 0x34
#define MINI_SPM_EXT 0
#define MINI_FLASH_BANKED 0
#define MINI_FLASH_128K 0
#define MINI_FLASH_256K 0
#define SPMCSR_IO 0x37
#define SPMCSR_MEM 0x57
#define WDT_IO 0x21
#define EEPROM_EECR_IO 0x1c
#define EEPROM_EEDR_IO 0x1d
#define EEPROM_EEARL_IO 0x1e
#define EEPROM_EEARH_IO 0x1f
#define UART_A_IO 0xb
#define UART_B_IO 0xa
#define UART_DATA_IO 0xc
#define UART_L_IO 0x9
#define UART_C_IO 0x20
#define UART_H_IO 0x20
#ifndef BOOT_BYTES
#define BOOT_BYTES 512
#endif
#define BOOT_START (FLASH_SIZE - BOOT_BYTES)
