/* Hardware configuration for attiny84. Generated by gen_devices.py. */
#define FLASH_SIZE 8192
#define EEPROM_SIZE 512
#define FLASH_PAGE_BYTES 64
#define SIG0 0x1e
#define SIG1 0x93
#define SIG2 0xc
#define SRAM_END 0x25f
#define MINI_UART_STYLE 5
#define MINI_LEGACY_STACK 1
#define MINI_VIRTUAL_BOOT 1
#define MCUSR_IO 0x34
#define MINI_SPM_EXT 0
#define MINI_FLASH_BANKED 0
#define MINI_FLASH_128K 0
#define MINI_FLASH_256K 0
#define SPMCSR_IO 0x37
#define SPMCSR_MEM 0x57
#define WDT_IO 0x21
#define EEPROM_EECR_IO 0x1c
#define EEPROM_EEDR_IO 0x1d
#define EEPROM_EEARL_IO 0x1e
#define EEPROM_EEARH_IO 0x1f
#define MINI_APP_VECTOR_WORD 14
#define SOFT_PORT_IO 0x1b
#define SOFT_DDR_IO 0x1a
#define SOFT_PIN_IO 0x19
#define SOFT_TX_BIT 1
#define SOFT_RX_BIT 2
#ifndef BOOT_BYTES
#define BOOT_BYTES 1024
#endif
#define BOOT_START (FLASH_SIZE - BOOT_BYTES)
