/* Hardware configuration for attiny841. Generated by gen_devices.py. */
#define FLASH_SIZE 8192
#define EEPROM_SIZE 512
#define FLASH_PAGE_BYTES 16
#define SIG0 0x1e
#define SIG1 0x93
#define SIG2 0x15
#define SRAM_END 0x2ff
#define MINI_UART_STYLE 3
#define MINI_LEGACY_STACK 1
#define MINI_VIRTUAL_BOOT 1
#define MCUSR_IO 0x34
#define MINI_SPM_EXT 0
#define MINI_FLASH_BANKED 0
#define MINI_FLASH_128K 0
#define MINI_FLASH_256K 0
#define SPMCSR_IO 0x37
#define SPMCSR_MEM 0x57
#define WDT_IO 0x21
#define EEPROM_EECR_IO 0x1c
#define EEPROM_EEDR_IO 0x1d
#define EEPROM_EEARL_IO 0x1e
#define EEPROM_EEARH_IO 0x1f
#define MINI_APP_VECTOR_WORD 14
#ifndef BOOT_BYTES
#define BOOT_BYTES 1024
#endif
#define BOOT_START (FLASH_SIZE - BOOT_BYTES)
